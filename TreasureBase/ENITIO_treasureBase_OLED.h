#include <SPI.h>
#include <Wire.h>
#include <Adafruit_GFX.h>
#include <Adafruit_SSD1306.h>

#define SCREEN_WIDTH 128 // OLED display width, in pixels
#define SCREEN_HEIGHT 64 // OLED display height, in pixels

#define hp_pxl_bar_width 100 // [pxl/HP]

// Declaration for an SSD1306 display connected to I2C (SDA, SCL pins)
// The pins for I2C are defined by the Wire-library.
// On an arduino UNO:       A4(SDA), A5(SCL)
// On an arduino MEGA 2560: 20(SDA), 21(SCL)
// On an arduino LEONARDO:   2(SDA),  3(SCL), ...

// the font height for font size 1 is 8
#define OLED_RESET -1       // Reset pin # (or -1 if sharing Arduino reset pin)
#define SCREEN_ADDRESS 0x3C ///< See datasheet for Address; 0x3D for 128x64, 0x3C for 128x32
Adafruit_SSD1306 display(SCREEN_WIDTH, SCREEN_HEIGHT, &Wire, OLED_RESET);

const unsigned char enitioLogo[] PROGMEM = {
    0x00, 0x00, 0x00, 0x00, 0x00, 0x00, 0x00, 0x00, 0x00, 0x00, 0x00, 0x00, 0x00, 0xf0, 0x00, 0x00,
    0x00, 0x00, 0x00, 0x00, 0x00, 0x00, 0x00, 0x00, 0x00, 0x00, 0x00, 0x00, 0x00, 0xff, 0x00, 0x00,
    0x00, 0x00, 0x00, 0x00, 0x00, 0x00, 0x00, 0x00, 0x00, 0x00, 0x00, 0x00, 0x00, 0xff, 0x40, 0x00,
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    0x00, 0x00, 0x00, 0x00, 0x00, 0x00, 0x00, 0x00, 0x00, 0x00, 0x00, 0x00, 0x00, 0x00, 0x00, 0x00};

void StartUpDisplay()
{
    display.clearDisplay();
    display.setTextSize(1); // Draw SIZE

    display.setTextColor(SSD1306_WHITE);

    display.drawBitmap(0, 4, enitioLogo, 128, 44, WHITE);

    display.setCursor(0, 56);
    display.println("   Please wait ...   ");
    display.display();
};

void displayNavBar()
{

    switch (display_nav_bar)
    {
    case 0:
        display.setTextColor(SSD1306_WHITE);
        display.setCursor(26, 56);
        display.println(F("< Main Menu >"));
        break;

    case 1:
        display.setTextColor(SSD1306_WHITE);
        display.setCursor(26, 56);
        display.println(F("<   Admin   >"));
        break;

    case 2:
        display.setTextColor(SSD1306_WHITE);
        display.setCursor(20, 56);
        display.println(F("< Base Profile  "));
        break;

    default:
        break;
    }
    display.display();
}

void displayProfile()
{
    display.clearDisplay();
    display.setTextSize(1);

    const char *clans[] = {"Invicta", "Dyanri", "Ephilia", "Akrona", "Solaris"};

    if (!TreasureBase_profile.isRegistered())
    {
        // Step 1: Display title
        display.setTextColor(SSD1306_BLACK, SSD1306_WHITE);
        display.setCursor(0, 0);
        display.println(" Choose your CLAN... ");

        // Step 2: Display clan selection menu
        display.setCursor(0, 13);
        display.setTextColor(SSD1306_WHITE);
        for (int i = 0; i < 5; ++i)
        {
            if (i == TreasureBase_profile.getClanPointer())
            {
                display.print("> ");
            }
            else
            {
                display.print("  ");
            }
            display.println(clans[i]);
        }
        display.setCursor(0, 56);
        display.setTextColor(SSD1306_BLACK, SSD1306_WHITE);
        display.println(" < Press to confirm > ");

        // Step 3: Handle clan selection and registration
        if (TreasureBase_joystick.read_Joystick() == button)
        {
            TreasureBase_profile.handleJoystickRegistered();
            // The next iteration of this function will show the registered clan
        }
    }
    else
    {
        // Step 4: Display registered clan info
        display.setCursor(0, 0);
        display.setTextColor(SSD1306_BLACK, SSD1306_WHITE);
        display.println("    Treasure Base    ");
        display.setCursor(0, 15);
        display.setTextColor(SSD1306_WHITE);
        display.println("Your registered clan:");
        display.setTextSize(1);
        display.println(" ");
        display.println(clans[TreasureBase_profile.getRegisteredClan()]);
        display.setCursor(0, 56);
        display.setTextColor(SSD1306_BLACK, SSD1306_WHITE);
        display.println(" Back to Main Menu >");

        // Step 5: Check for button press to return to main menu
        if (TreasureBase_joystick.read_Joystick() == button)
        {
            ProfileFunction = false; // Return to main menu
            display_nav_bar = 0;
            TreasureBase_profile.CLANRegistered();
        }
    }

    display.display();
}